## arch/arm/src/zynqmp-rpu/Kconfig
```kconfig
#
# For a description of the syntax of this configuration file,
# see the file kconfig-language.txt in the NuttX tools repository.
#

if ARCH_CHIP_ZYNQMP_RPU

comment "ZynqMP RPU Configuration Options"

# Summary Configurations

menu "ZynqMP RPU Peripheral Support"

config ZYNQMP_RPU_UART0
      bool "UART 0"
      default y
      select UART0_SERIALDRIVER
      select ARCH_HAVE_SERIAL_TERMIOS

config ZYNQMP_RPU_UART1
      bool "UART 1"
      default n
      select UART1_SERIALDRIVER
      select ARCH_HAVE_SERIAL_TERMIOS

endmenu # ZynqMP RPU Peripheral Support

menu "ZynqMP RPU Timebase"

config ZYNQMP_RPU_TIMEBASE_TTC
      int "Timebase TTC (0-3)"
      default 2
      range 0 3
      ---help---
            TTC module whose counter runs freely as the timebase for
            up_udelay().  Under remoteproc, Linux must not use it: disable
            it in the device tree.  On the KV260, TTC0 drives the fan.

config ZYNQMP_RPU_TIMEBASE_COUNTER
      int "Timebase counter (0-2)"
      default 1
      range 0 2
      ---help---
            Counter of the timebase TTC.  The system tick uses TTC2
            counter 0.

endmenu # ZynqMP RPU Timebase

endif # ARCH_CHIP_ZYNQMP_RPU
```

## arch/arm/src/zynqr5/Kconfig
```kconfig
#
# For a description of the syntax of this configuration file,
# see the file kconfig-language.txt in the NuttX tools repository.
#

if ARCH_CHIP_ZYNQR5

comment "Zynq UltraScale+ MPSoC R5F Peripheral Support"

menu "UART Configuration"

config ZYNQR5_UART0
	bool "UART 0 (PS UART0 at 0xFF000000)"
	default n
	select UART0_SERIALDRIVER
	select ARCH_HAVE_SERIAL_TERMIOS

config ZYNQR5_UART0_CONSOLE
	bool "Use UART0 as the NuttX console"
	default n
	depends on ZYNQR5_UART0

config ZYNQR5_UART1
	bool "UART 1 (PS UART1 at 0xFF010000)"
	default n
	select UART1_SERIALDRIVER
	select ARCH_HAVE_SERIAL_TERMIOS

config ZYNQR5_UART1_CONSOLE
	bool "Use UART1 as the NuttX console"
	default n
	depends on ZYNQR5_UART1

endmenu

menu "TTC Timer Configuration"

config ZYNQR5_TTC1
	bool "Triple Timer Counter 1 (TTC1)"
	default n

config ZYNQR5_TTC_COUNTER0
	bool "Use TTC1 counter 0 as system tick source"
	default n
	depends on ZYNQR5_TTC1

config ZYNQR5_TTC_FREQ
	int "TTC input clock frequency (Hz)"
	default 100000000
	depends on ZYNQR5_TTC1

config ZYNQR5_TTC_HRT
	bool "Dedicate a second TTC to a high-resolution timer"
	default n
	---help---
		Claims a TTC counter separate from the system tick so the PX4 layer
		can provide a microsecond-resolution hrt_absolute_time() instead of
		reading the tick-backed CLOCK_MONOTONIC.

		This only reserves the hardware and publishes its addresses; the
		driver itself lives in the PX4 platform layer
		(platforms/nuttx/src/px4/amd/zynqr5/hrt).

		NOTE on ownership: TTC0 is used by Linux on the Kria KV260 (bound to
		ttc-pwm, exposing pwmchip0).  All four TTCs are status="okay" in the
		Linux device tree, so check for a bound driver rather than trusting
		the DT when choosing.

		The defaults below name TTC2, but the Kria KV260 deliberately does
		NOT use it: TTC2 and TTC3 have their reference clocks gated in
		CRL_APB, so a counter programmed there never increments.  That board
		puts the HRT on TTC1 counter 1 (IRQ 72) alongside the system tick on
		counter 0 instead of ungating a clock, because that would mean a
		read-modify-write to a reset register that has already cost the board
		one power cycle.  See boards/amd/kria-kv260/nuttx-config/nsh/defconfig.

if ZYNQR5_TTC_HRT

config ZYNQR5_TTC_HRT_BASE
	hex "HRT TTC register base address"
	default 0xff130000
	---help---
		TTC0 0xff110000, TTC1 0xff120000, TTC2 0xff130000, TTC3 0xff140000.
		Must differ from the TTC used for the system tick.

config ZYNQR5_TTC_HRT_COUNTER
	int "HRT TTC counter index within that TTC (0-2)"
	default 0
	range 0 2

config ZYNQR5_TTC_HRT_IRQ
	int "GIC IRQ number for that TTC counter"
	default 74
	---help---
		TTC2 counter 0 is SPI 42, i.e. IRQ 74.  See
		arch/arm/include/zynqr5/irq.h for the full map.

config ZYNQR5_TTC_HRT_PRESCALE_LOG2
	int "HRT prescaler exponent: divide input clock by 2^(N+1)"
	default 5
	range 0 15
	---help---
		The TTC prescaler only divides by powers of two, so an exact 1 MHz
		count cannot be produced from a 100 MHz input.  N=5 divides by 64,
		giving 1.5625 MHz (0.64 us per count), and microseconds convert
		exactly as count * 16 / 25 with no accumulating error.

endif

endmenu

config ZYNQR5_ICACHE
	bool "Cache instruction fetch from the DDR carveout"
	default n
	select ARM_MPU
	---help---
		Program one MPU region marking the DDR carveout Normal Write-Back
		cacheable, then enable the L1 instruction cache.

		This R5F runs its whole ~1.4 MB .text from external DDR.  Without
		this, every instruction fetch is uncached: the TCM boot stub clears
		SCTLR.M to drop the FSBL's regions, and on ARMv7-R a disabled MPU
		selects the default memory map, under which caches cannot be used.

		The DATA cache is deliberately NOT enabled.  The resource table
		(vdev status, polled here and written by Linux), the RSC_TRACE ring
		and the vrings are all shared with the A53, and the resource table
		is only 8-byte aligned in the middle of .data, so it cannot be given
		its own region without relocating it.  Leaving SCTLR.C clear keeps
		every one of them coherent with no cache maintenance.

		mpu_control() also sets SCTLR_BR, so everything outside the carveout
		-- TCM, vrings, GIC, MMIO -- keeps its previous behaviour.

config ZYNQR5_DCACHE
	bool "Also enable the L1 data cache"
	default n
	depends on ZYNQR5_ICACHE
	---help---
		Set SCTLR.C so data accesses to the DDR carveout are cached too.

		Separate from ZYNQR5_ICACHE because this is the half with the
		coherency hazards, and keeping it its own symbol means it can be
		turned off again without touching code -- useful for A/B measurement
		and for bisecting a suspected coherency bug.

		Enabling ZYNQR5_ICACHE already carves the two areas Linux touches
		inside the carveout back out as Strongly-Ordered: the resource table
		(whose RSC_VDEV status field Linux writes while this core polls it)
		and the RSC_TRACE ring plus debug scratchpad.  The vrings and the
		rpmsg buffer pool sit outside the carveout and are left on the
		default memory map by SCTLR_BR.

		If a coherency case was missed, the classic symptom is a firmware
		that loads, reports "running", and never announces its rpmsg
		channels, because rptun is spinning on a stale vdev status.

config ZYNQR5_RPTUN
	bool "ZynqMPSoC R5F rptun/OpenAMP IPC"
	depends on RPTUN
	default n
	---help---
		Enable virtio rpmsg IPC from R5F to A53 via NuttX rptun.
		Requires GICC access (XMPU unlock via BOOT.bin, Phase 3).

endif # ARCH_CHIP_ZYNQR5
```

## boards/arm/zynqmp-rpu/kv260-rpu/Kconfig
```kconfig
#
# For a description of the syntax of this configuration file,
# see the file kconfig-language.txt in the NuttX tools repository.
#

if ARCH_BOARD_KV260_RPU

config KV260_RPU_QEMU
	bool "Build for Xilinx QEMU"
	default n
	---help---
		Adjust board clock assumptions for Xilinx QEMU instead of real
		KV260 hardware.  QEMU's TTC model counts at a fixed 133 MHz
		regardless of the clock in its hardware device tree, so the
		system tick runs about 1.33x fast with the hardware value.

config KV260_RPU_RPMSG_ECHO
	bool "RPMsg echo service"
	default n
	depends on RPTUN
	---help---
		Create an RPMsg endpoint named "rpmsg-raw" on the link to Linux and
		send every message it receives back to the sender.  Linux's
		rpmsg_char driver binds to that name and exposes the endpoint as
		/dev/rpmsgN, which makes it easy to test the link from Linux.

endif # ARCH_BOARD_KV260_RPU
```

## fs/rpmsgfs/Kconfig
```kconfig
#
# For a description of the syntax of this configuration file,
# see the file kconfig-language.txt in the NuttX tools repository.
#

config FS_RPMSGFS
	bool "RPMSG File System"
	default n
	depends on RPTUN
	---help---
		Use rpmsg file system to mount remote directories to local.
		This the method for user to use remote file like own core.

config FS_RPMSGFS_BIND_TIMEOUT_MS
	int "Name-service bind timeout (milliseconds)"
	default 0
	depends on FS_RPMSGFS
	---help---
		How long a path-based operation waits for the remote server to bind
		this client's endpoint by name service before failing.

		0 (the default) waits forever, which is the historical behaviour: the
		first operation on the mount blocks until the remote appears, and if it
		never appears the caller never returns.  On a system where that first
		operation happens on the boot path, a remote that is absent or crashed
		therefore stops the boot rather than degrading it.

		Set a non-zero value to make the wait bounded.  Operations then fail
		with -ENOMEM until the remote binds, and the mount's own "timeout="
		option decides how long to keep retrying, so a missing server costs a
		bounded delay and an unavailable filesystem instead of a hang.
```
